/ {
    chosen {
        app-led = &green_led_4;
    };
    /* node_a { */
    /*     compatible = "custom-cells-a"; */
    /*     #gpio-cells = <3>; */
    /* }; */
};
/* &green_led_4 { */
/*     gpios = <&{/node_a} 1 2 3>; */
/* }; */
