/ {
    aliases {
	my-button = &button_1;
    };
    
    buttons {
	compatible = "gpio-keys";
	button_1: button {
	    gpios = <&gpioa 0 GPIO_ACTIVE_HIGH>;
	    zephyr,code = <INPUT_KEY_0>;
	};
    };
};
