## CMakeLists.txt
```
# SPDX-License-Identifier: Apache-2.0

cmake_minimum_required(VERSION 3.20.0)

set(BOARD qemu_x86_64)
set(DTC_OVERLAY_FILE "dts/playground/props-basics.overlay")



find_package(Zephyr REQUIRED HINTS $ENV{ZEPHYR_BASE})
project(hello_world)

target_sources(app PRIVATE src/main.c)
```

## prj.conf
```kconfig
CONFIG_BOOT_BANNER=y
CONFIG_PRINTK=y
```

## dts/playground/props-basics.overlay
```dts
/ {
  label_with_props: node_with_props {
    compatible = "custom-props-basics";
    existent-boolean;
    int = <1>;
    array = <0xA second_value: 0xB 0xC>;
    uint8-array = [ 12 34  ];
    string = string_value: "foo bar baz";
    string-array = "foo", "bar", "baz";
    enum-int = <200>;
    enum-string = "whatever";
  };
};
```

## dts/bindings/custom,props-basic.yaml
```yaml
description: Custom properties
compatible: "custom,props-basic"

properties:
  int:
    type: int
  string:
    type: string
```

## dts/bindings/custom-props-basics.yaml
```yaml
description: Custom properties

# The following compatible key does not use the value "custom,props-basics"
# since the vendor "custom" doesn't exist in the vendor-prefixes.txt.
# The generation doesn't fail but it leads to the following message:
# compatible 'custom-props-basics' has unknown vendor prefix 'dummy'
compatible: "custom-props-basics"

properties:
  existent-boolean:
    type: boolean
  int:
    type: int
    required: true
  array:
    type: array
  uint8-array:
    type: uint8-array
  string:
    type: string
  string-array:
    type: string-array
  enum-int:
    type: int
    enum:
      - 100
      - 200
      - 300
  enum-string:
    type: string
    enum:
      - "whatever"
      - "works"
```

## src/main.c
```c
#include <zephyr/kernel.h>

int main(void)
{
    int n = 0;

    while (1)
    {
	printk("Hello, World\r\n");
	k_msleep(1000);
    }
    return 0;
}
```
