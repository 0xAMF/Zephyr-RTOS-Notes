## examples/modules/button/drivers/button/Kconfig
```kconfig
config CUSTOM_BUTTON
    bool "Custom Button"
    default n
    depends on GPIO
    help
	Enable custom button driver
```

## examples/modules/button/dts/bindings/input/custom,button.yaml
```yaml
description: custom button

# compatiblity string that matches the one in the devicetree source 
# and DT_DRV_COMPAT macr in the driver source code
compatible: "custom,button"

# define requried properties
properties:
  pin:
    type: phandle
    required: true
```

## examples/modules/say_hello/Kconfig
```kconfig
config SAY_HELLO
    bool "Print test to console"
    default n
    depends on PRINTK
    help
	adds say_hello() function to print "hello"
```
